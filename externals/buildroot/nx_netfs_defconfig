## externals/buildroot/nx_netfs_defconfig
```kconfig
BR2_arm=y
BR2_cortex_a9=y
BR2_ARM_ENABLE_NEON=y
BR2_ARM_ENABLE_VFP=y
BR2_ARM_FPU_NEON=y
BR2_CCACHE=y
BR2_KERNEL_HEADERS_3_4=y
BR2_TOOLCHAIN_BUILDROOT_GLIBC=y
BR2_PACKAGE_SMBNETFS=y
BR2_PACKAGE_SSHFS=y
BR2_PACKAGE_UNIONFS=y
BR2_PACKAGE_RSYNC=y
BR2_PACKAGE_SAMBA4=y
```

## externals/buildroot/smbnetfs/Config.in
```kconfig
config BR2_PACKAGE_SMBNETFS
	bool "smbnetfs"
	depends on BR2_PACKAGE_SAMBA4
	select BR2_PACKAGE_LIBFUSE
	select BR2_PACKAGE_LIBICONV if !BR2_ENABLE_LOCALE
	help
        A user-space filesystem that contains an entire
        SMB/NMB network under a single mount point.
        Workgroups, servers, and shares can be browsed much
        like the Network Neighborhood in Microsoft Window.

        http://smbnetfs.sourceforge.net/

comment "smbnetfs needs samba"
	depends on !BR2_PACKAGE_SAMBA
```
